`timescale 1ns / 1ps

// ============================================================================
//  mm2s_datapath
// ============================================================================
// Takes a job of "read BTT bytes starting at address SA",
// splits it into multiple bursts that follow the AXI rules, issues them, and pushes the returned data into the FIFO
//
// R0 : DDR (HP0)          camera frame buffer
// R1 : BRAM frame window  loading screen (virtual frame generated by ram_bridge)
// ============================================================================
module mm2s_datapath #(
    parameter ADDR_WIDTH   = 32,        // Address width
    parameter DATA_WIDTH   = 32,        // Data width (1 beat)
    parameter LEN_WIDTH    = 32,        // Transfer length (BTT) width
    parameter BURST_WIDTH  = 8,         // ARLEN width

    parameter [ADDR_WIDTH-1:0] R0_BASE = 32'h0000_0000,   // Region0 start : DDR
    parameter [ADDR_WIDTH-1:0] R0_SIZE = 32'h4000_0000,   // Region0 size  : 1GB
    parameter [ADDR_WIDTH-1:0] R1_BASE = 32'h8000_0000,   // Region1 start : BRAM frame window
    parameter [ADDR_WIDTH-1:0] R1_SIZE = 32'h002A_3000,   // Region1 size  : 1280x720x3

    parameter MAX_BURST_BYTES = 64                        // burst limit 64B = 16 beat
)(
    input                            clk,
    input                            rst_n,

    // ------------------------------------------------------------------
    // Commands from the Controller
    // ------------------------------------------------------------------
    input                            en,    // 1 = OK to work (when the controller is in S_DATA)
    input                            init,  // 1 clock : frame start
    input                            abort, // 1 clock : stop issuing new requests 

    // ------------------------------------------------------------------
    // Config values (from the register map / frame select)
    // ------------------------------------------------------------------
    input      [ADDR_WIDTH-1:0]      src_addr,    // Read start address
    input      [LEN_WIDTH-1:0]       length,      // Total number of bytes to read
    input      [BURST_WIDTH+1:0]     burst_cfg,   // [7:0] desired ARLEN, [9:8] burst type

    // ------------------------------------------------------------------
    // Reports to the Controller
    // ------------------------------------------------------------------
    output                           r_hs,        // R channel handshake
    output                           xfer_done,   // Signals that this frame is done
    output     [ADDR_WIDTH-1:0]      err_addr,    // Address of the first error beat
    output reg                       err_valid,   // Error response received
    output reg                       cfg_err,     // Cannot proceed due to invalid configuration

    // ------------------------------------------------------------------
    // Pass data to the FIFO
    // ------------------------------------------------------------------
    output reg                       fifo_wr_en,
    output reg [DATA_WIDTH-1:0]      fifo_wr_data,
    input                            fifo_full,

    // ------------------------------------------------------------------
    // AXI4 AR channel (order form)
    // ------------------------------------------------------------------
    output reg [4:0]                 arid,        // {DMA flag 1bit, reserved 2bit, slot number 2bit}
    output reg [ADDR_WIDTH-1:0]      araddr,      // Start address of this burst
    output reg [BURST_WIDTH-1:0]     arlen,       // number of beats - 1
    output     [2:0]                 arsize,      // beat size (fixed at 4 bytes)
    output     [1:0]                 arburst,     // burst type
    output reg                       arvalid,     // "I have an order"
    input                            arready,     // "Order received"

    // ------------------------------------------------------------------
    // AXI4 R channel (goods)
    // ------------------------------------------------------------------
    input      [DATA_WIDTH-1:0]      rdata,       // Data
    input                            rvalid,      // "Goods have arrived"
    input                            rlast,       // "This is the last beat of this burst"
    input      [4:0]                 rid,         // Which order (ARID) it belongs to
    input      [1:0]                 rresp,       // 00 OK, 10 SLVERR, 11 DECERR
    output                           rready       // "I can accept"
);

    // ########################################################################
    //  0. Constants
    // ########################################################################
    localparam [0:0] MASTER_ID      = 1'b1;                     // ARID[4] : "this is a DMA order"
    localparam BYTES_PER_BEAT       = DATA_WIDTH/8;             // 4
    localparam ADDR_LSB             = $clog2(BYTES_PER_BEAT);   // 2 : byte <-> beat conversion
    localparam PAGE_BYTES           = 4096;                     // AXI rule : a burst cannot cross a 4KB boundary
    localparam PAGE_LSB             = $clog2(PAGE_BYTES);       // 12
    localparam MAX_BURST_BEATS      = MAX_BURST_BYTES / BYTES_PER_BEAT;  // 16
    localparam [2:0] ARSIZE_VAL     = ADDR_LSB;                 // 3'b010 = 4 bytes/beat

    localparam MAX_OUTSTANDING   = 3;                            // Number of orders that can be in flight at once
    localparam OUTSTANDING_CNT_W = $clog2(MAX_OUTSTANDING + 1);  // Bits needed to count 0~3 = 2
    localparam SLOT_IDX_W        = (MAX_OUTSTANDING > 1) ? $clog2(MAX_OUTSTANDING) : 1;  // Slot number bits = 2

    localparam [1:0] BURST_FIXED = 2'b00;                        // Fixed address (same address repeated)
    localparam [1:0] BURST_INCR  = 2'b01;                        // Incrementing address (the usual one)

    localparam [ADDR_WIDTH-1:0] R0_END = R0_BASE + R0_SIZE;      // End of region0 (this address is excluded)
    localparam [ADDR_WIDTH-1:0] R1_END = R1_BASE + R1_SIZE;      // End of region1 (this address is excluded)

    assign arsize = ARSIZE_VAL;                                  // Always 4 bytes/beat

    // ########################################################################
    //  1. Config values snapshotted at init
    //     So that the CPU changing registers mid-transfer does not affect this frame,
    //     the "values at the start moment" are stored separately and used (actual storage is in block 9)
    // ########################################################################
    reg  [BURST_WIDTH+1:0] burst_cfg_q;     // Snapshotted BURST_CFG
    reg  [LEN_WIDTH-1:0]   total_beats_q;   // Snapshotted total beat count (= BTT / 4)
    reg                    align_err_q;     // Whether there was an alignment error at start
    reg  [ADDR_WIDTH-1:0]  cur_addr;        // Address for the next order (advances every burst)
    reg  [LEN_WIDTH-1:0]   req_beat_cnt;    // Number of beats ordered so far

    // Split BURST_CFG into two fields
    wire [1:0]             burst_type_cfg = burst_cfg_q[BURST_WIDTH+1:BURST_WIDTH];  // [9:8] type
    wire [BURST_WIDTH-1:0] burst_len_cfg  = burst_cfg_q[BURST_WIDTH-1:0];            // [7:0] length
    assign arburst = burst_type_cfg;

    // If the type is 10(WRAP) or 11(reserved), the upper bit is 1 -> unsupported
    wire burst_type_err = burst_type_cfg[1];

    // Alignment check : address and length must be multiples of 4 (lower 2 bits are 00)
    // Since a beat is 4 bytes, bytes straddling a beat cannot be handled if not a multiple of 4
    wire align_err_c = (src_addr[ADDR_LSB-1:0] != {ADDR_LSB{1'b0}}) ||
                       (length[ADDR_LSB-1:0]   != {ADDR_LSB{1'b0}});

    // Total bytes -> total beats ( / 4)
    wire [LEN_WIDTH-1:0] total_beats_c = length >> ADDR_LSB;

    // ########################################################################
    //  2. Progress
    // ########################################################################
    // Are there beats not yet ordered?
    wire req_pending = (req_beat_cnt < total_beats_q);

    // Remaining beats (used for the burst length calculation)
    wire [LEN_WIDTH-1:0] remain_beats = total_beats_q - req_beat_cnt;

    // ########################################################################
    //  3. Address region check : is the current address inside DDR or the BRAM window?
    // ########################################################################
    wire in_r0 = (cur_addr >= R0_BASE) && (cur_addr < R0_END);   // Inside DDR?
    wire in_r1 = (cur_addr >= R1_BASE) && (cur_addr < R1_END);   // Inside the BRAM window?

    // End address of the current region (used to cut bursts so they don't cross the region)
    wire [ADDR_WIDTH-1:0] region_end_c = in_r0 ? R0_END : R1_END;

    // Error if there is still something to order but the address is in neither region
    wire region_err_c = req_pending && !in_r0 && !in_r1;

    // ########################################################################
    //  4. handshake signals 
    // ########################################################################
    wire ar_hs = arvalid && arready;

    assign r_hs   = rvalid && rready;      // One beat has just arrived
    assign rready = !fifo_full;            // Always accept while the FIFO has room

    wire r_mine      = (rid[4] == MASTER_ID);   // Is it for my (DMA) order? (check the top bit of the ID)
    wire r_beat      = r_hs && r_mine;          // A beat of my order has arrived
    wire r_burst_end = r_beat && rlast;         // And it is the last beat of that order

    // ########################################################################
    //  5. Outstanding management (up to 3 at once)
    //
    //     Slot = order ticket number (0, 1, 2)
    //       num_busy[i]  : whether slot i is in use
    //       slot_addr[i] : start address of order i   -> for back-calculating the error address
    //       slot_beat[i] : beats received for order i -> for back-calculating the error address
    //     When sending an order, the slot number goes in the lower 2 bits of ARID,
    //     and when goods arrive, the lower 2 bits of RID identify the slot
    // ########################################################################
    reg [MAX_OUTSTANDING-1:0]   num_busy;
    reg [ADDR_WIDTH-1:0]        slot_addr [0:MAX_OUTSTANDING-1];
    reg [BURST_WIDTH-1:0]       slot_beat [0:MAX_OUTSTANDING-1];
    reg [OUTSTANDING_CNT_W-1:0] outstanding_cnt;   // Number of orders in flight (0~3)
    reg [SLOT_IDX_W-1:0]        ar_num_q;          // Slot number of the order currently going out

    // Lowest-numbered free slot
    // (if all three are full this yields 2, but then outstanding_ok = 0 so no order is issued)
    wire [1:0] next_num = (!num_busy[0]) ? 2'd0 : (!num_busy[1]) ? 2'd1 : 2'd2;

    // Count orders in flight
    //   order accepted (ar_hs)     -> +1
    //   order complete (last beat) -> -1
    //   both in the same clock     -> unchanged
    always @(posedge clk) begin
        if (!rst_n)      outstanding_cnt <= '0;
        else if (init)   outstanding_cnt <= '0;
        else begin
            case ({ar_hs, r_burst_end})
                2'b10:   outstanding_cnt <= outstanding_cnt + 1'b1;
                2'b01:   outstanding_cnt <= outstanding_cnt - 1'b1;
                default: outstanding_cnt <= outstanding_cnt;
            endcase
        end
    end
    // Slot in-use flags
    //   order accepted -> that slot is in use
    //   last beat arrives -> free the slot found via RID
    always @(posedge clk) begin
        if (!rst_n)      num_busy <= '0;
        else if (init)   num_busy <= '0;
        else begin
            if (ar_hs)       num_busy[ar_num_q] <= 1'b1;
            if (r_burst_end) num_busy[rid[1:0]] <= 1'b0;
        end
    end
    // Is there a free slot?
    wire outstanding_ok = (outstanding_cnt < MAX_OUTSTANDING);

    // ########################################################################
    //  6. Remember abort
    //     abort is a 1-clock pulse -> once it arrives, hold it at 1 until this frame ends
    //     -> no more new orders are sent, but goods for orders already sent are received to the end
    // ########################################################################
    reg abort_lat;
    always @(posedge clk) begin
        if (!rst_n)      abort_lat <= 1'b0;
        else if (init)   abort_lat <= 1'b0;
        else if (abort)  abort_lat <= 1'b1;
    end

    // ########################################################################
    //  7. Determine the length of this burst
    //     For INCR, the smallest of the following 4
    //       (a) config     : BURST_CFG[7:0] + 1, max 16
    //       (b) 4KB bound  : beats left until the next 4KB boundary
    //       (c) region end : beats left until the end of the current region
    //       (d) remaining  : beats not yet ordered
    // ########################################################################

    // (b) Up to the 4KB boundary : 4096 - (lower 12 bits of the address)
    wire [LEN_WIDTH-1:0] bytes_to_boundary = PAGE_BYTES - {{(LEN_WIDTH-PAGE_LSB){1'b0}}, cur_addr[PAGE_LSB-1:0]};
    wire [LEN_WIDTH-1:0] beats_to_boundary = bytes_to_boundary >> ADDR_LSB;

    // (c) Up to the end of the region
    wire [LEN_WIDTH-1:0] bytes_to_region   = region_end_c - cur_addr;
    wire [LEN_WIDTH-1:0] beats_to_region   = bytes_to_region >> ADDR_LSB;

    // (a) Config value : ARLEN is "beats - 1", so add 1 to get beats; clamp to 16 if above 16
    wire [LEN_WIDTH-1:0] desired_raw   = {{(LEN_WIDTH-BURST_WIDTH){1'b0}}, burst_len_cfg} + 1'b1;
    wire [LEN_WIDTH-1:0] desired_beats = (desired_raw > MAX_BURST_BEATS) ? MAX_BURST_BEATS
                                                                         : desired_raw;

    // The smaller of (b) and (c)
    //wire [LEN_WIDTH-1:0] limit_beats = (beats_to_boundary < beats_to_region) ? beats_to_boundary : beats_to_region;
    wire [LEN_WIDTH-1:0] limit_beats = beats_to_boundary;

    // FIXED : the address doesn't move, so no boundary concern -> min(remaining, config, 16)
    wire [LEN_WIDTH-1:0] safe_beats_fixed = (remain_beats < desired_beats) ?  ((remain_beats  < 16) ? remain_beats  : 16) : ((desired_beats < 16) ? desired_beats : 16);

    // INCR : min(config, boundary, remaining)  (boundary = smaller of 4KB and region end)
    wire [LEN_WIDTH-1:0] safe_beats_incr = (desired_beats < limit_beats) ?
            ((desired_beats < remain_beats) ? desired_beats : remain_beats) : ((limit_beats   < remain_beats) ? limit_beats   : remain_beats);

    // Final beat count (0 for unsupported types -> no order is issued)
    wire [LEN_WIDTH-1:0] safe_beats = (burst_type_cfg == BURST_FIXED) ? safe_beats_fixed : (burst_type_cfg == BURST_INCR)  ? safe_beats_incr  : {LEN_WIDTH{1'b0}};

	reg [LEN_WIDTH-1:0] safe_beats_reg;
	reg                 safe_beats_valid;
	
	
	//Is it OK to compute the burst length and store it in the FF?
	wire safe_calc_en = en && !init
			&& !arvalid
	    	&& !safe_beats_valid
	    	&& req_pending
			&& !abort
	    	&& !abort_lat
	    	&& outstanding_ok
	    	&& !cfg_err
	    	&& !region_err_c;
	
	always @(posedge clk) begin
	    if (!rst_n || init) begin
	        safe_beats_reg     <= {LEN_WIDTH{1'b0}};
	        safe_beats_valid <= 1'b0;
	    end
	    else begin
	        // Consumed by the next stage
	        if (!arvalid && safe_beats_valid)
	            safe_beats_valid <= 1'b0;
	
	        // Store the newly computed burst length
	        if (safe_calc_en) begin
	            safe_beats_reg     <= safe_beats;
	            safe_beats_valid <= 1'b1;
	        end
	    end
	end


    wire [LEN_WIDTH-1:0]   safe_bytes = safe_beats_reg << ADDR_LSB;            // beat -> bytes (×4) : address increment
    wire [BURST_WIDTH-1:0] safe_arlen = safe_beats_reg[BURST_WIDTH-1:0] - 1'b1; // ARLEN = beats - 1

    // ########################################################################
    //  8. Check whether an order may be issued / config errors
    // ########################################################################
	// Is it OK to send the stored burst info out on the AXI AR channel?
    wire ar_can_issue = en && !init          // Working, and not the start clock (config being latched)
                        && !arvalid          // No previous order still waiting to be accepted
                        && req_pending       // Something left to order
                        && !abort_lat        // No stop requested
                        && outstanding_ok    // A slot is free
                        && (safe_beats_reg != {LEN_WIDTH{1'b0}})   // Length is not 0
                        && !cfg_err          // No config error
                        && !region_err_c     // Address within an allowed region
						&& safe_beats_valid
						&& !abort ;

    // Something remains but the length computed to 0 = no way to make further progress
    wire no_progress = en && !init && req_pending && !abort_lat && !abort
                       && (safe_beats_reg == {LEN_WIDTH{1'b0}})&& safe_beats_valid;

    // Config error flag
    //   At init : 1 immediately on alignment error (otherwise cleared to 0)
    //   While working : no progress / alignment error / out of region / unsupported burst type -> 1
    //   Once 1, held until the next init -> ordering stops -> xfer_done after all issued orders are received
    always @(posedge clk) begin
        if (!rst_n) cfg_err <= 1'b0;
        else if (init) cfg_err <= align_err_c;
        else if (en && (no_progress || align_err_q || region_err_c || burst_type_err))
            cfg_err <= 1'b1;
    end

    // ########################################################################
    //  9. Latch config values + advance address/count
    // ########################################################################
    always @(posedge clk) begin
        if (!rst_n) begin
            cur_addr       <= {ADDR_WIDTH{1'b0}};
            req_beat_cnt   <= {LEN_WIDTH{1'b0}};
            total_beats_q  <= {LEN_WIDTH{1'b0}};
            align_err_q    <= 1'b0;
            burst_cfg_q    <= {(BURST_WIDTH+2){1'b0}};
            slot_addr      <= '{default: '0};
            slot_beat      <= '{default: '0};
        end
        // ----- Frame start : snapshot config values -----
        else if (init) begin
            cur_addr       <= src_addr;         // Start address
            req_beat_cnt   <= {LEN_WIDTH{1'b0}}; // Ordered count starts at 0
            total_beats_q  <= total_beats_c;    // Total beats
            align_err_q    <= align_err_c;      // Alignment error flag
            burst_cfg_q    <= burst_cfg;        // Burst config
            slot_addr      <= '{default: '0};   // Clear slot records
            slot_beat      <= '{default: '0};
        end
        // ----- During transfer -----
        else begin
            // New order accepted -> that slot's received beat count starts at 0
            if (ar_hs)  slot_beat[ar_num_q] <= {BURST_WIDTH{1'b0}};
            // Beat arrives -> +1 to the received beat count of the slot found via RID
            if (r_beat) slot_beat[rid[1:0]] <= slot_beat[rid[1:0]] + 1'b1;

            if (ar_hs) begin
                // For INCR, advance the next order address by this burst's size (FIXED stays put)
                if (burst_type_cfg == BURST_INCR) cur_addr <= cur_addr + safe_bytes[ADDR_WIDTH-1:0];
				req_beat_cnt        <= req_beat_cnt + safe_beats_reg;   // Accumulate ordered count
                slot_addr[ar_num_q] <= araddr;                      // Record this slot's start address
            end
        end
    end

    // ########################################################################
    //  10. AR channel : send out orders
    //      AXI rule : once ARVALID is raised, its contents must not change until ARREADY arrives
    //      -> after raising it, hold still until accepted (ar_hs), then lower it
    // ########################################################################
    always @(posedge clk) begin
        if (!rst_n) begin
            arvalid    <= 1'b0;
            araddr     <= {ADDR_WIDTH{1'b0}};
            arlen      <= {BURST_WIDTH{1'b0}};
            arid       <= 5'd0;
            ar_num_q   <= '0;
        end
        else if (ar_hs) begin
            arvalid <= 1'b0;                                // Accepted, so lower it
        end
        else if (ar_can_issue) begin
            arvalid    <= 1'b1;                             // New order
            araddr     <= cur_addr;                         // Address
            arlen      <= safe_arlen;                       // Length
            arid       <= {MASTER_ID, 2'b00, next_num};     // {DMA, reserved, slot number}
            ar_num_q   <= next_num;                         // Remember which slot
        end
    end

    // ########################################################################
    //  11. R channel -> FIFO
    //      Each time a beat of my order arrives, write it straight into the FIFO
    //      (when the FIFO is full, rready = 0 so nothing arrives -> it can never overflow)
    // ########################################################################
    always @(*) begin
        fifo_wr_en   = r_beat;
        fifo_wr_data = rdata;
    end

    // ########################################################################
    //  12. Back-calculate the error address
    //      RRESP[1] = 1 means SLVERR(10) or DECERR(11) = bad
    //      Address of the bad beat = slot start address + (beats previously received in that slot × 4)
    //        e.g.) slot1 starts at 0x1000_0100, 3 beats already received and the 4th is bad
    //            -> 0x1000_0100 + 3×4 = 0x1000_010C
    //      For FIXED the address doesn't move, so it is just the start address
    // ########################################################################
    wire beat_err = r_beat && rresp[1];

    wire [ADDR_WIDTH-1:0] beat_addr = (burst_type_cfg == BURST_FIXED) ? slot_addr[rid[1:0]] : slot_addr[rid[1:0]] +
              ({{(ADDR_WIDTH-BURST_WIDTH){1'b0}}, slot_beat[rid[1:0]]} << ADDR_LSB);

    reg [ADDR_WIDTH-1:0] err_addr_q;
    assign err_addr = err_addr_q;

    // Record only the first bad beat (the first one matters most for finding the root cause)
    // Note : even on a response error, ordering does not stop and this frame is received to the end.
    //        The controller decides whether to repeat (no next frame if there is an error)
    always @(posedge clk) begin
        if (!rst_n) begin
            err_valid  <= 1'b0;
            err_addr_q <= {ADDR_WIDTH{1'b0}};
        end
        else if (init) begin
            err_valid  <= 1'b0;
            err_addr_q <= {ADDR_WIDTH{1'b0}};
        end
        else if (beat_err && !err_valid) begin
            err_valid  <= 1'b1;
            err_addr_q <= beat_addr;
        end
    end

    // ########################################################################
    //  13. Done? (xfer_done)
    //      Done when "nothing more to order" + "all goods for sent orders have arrived"
    //        Nothing to order when : everything ordered / abort / config error
    //      !init : excluded because the start clock may still hold the previous frame's values
    //              (prevents counting the same frame end twice in cyclic mode)
    // ########################################################################
    wire ar_done = !req_pending || abort_lat || cfg_err;

    assign xfer_done = !init && ar_done && (outstanding_cnt == '0);

endmodule
